## Kconfig
```kconfig
source "Kconfig.zephyr"

menu "ZMK USB Bridge"

config ZMK_USB_BRIDGE_PAIRING_NAME_ALLOWLIST_ENABLED
    bool "Enable pairing name allowlist"
    default n
    help
      When enabled, the bridge will use an exact-match local name allowlist
      as an additional filter during unbonded pairing.

config ZMK_USB_BRIDGE_PAIRING_NAME_ALLOWLIST
    string "Pairing name allowlist"
    default ""
    help
      Comma-separated exact-match local names that are accepted during
      unbonded pairing when the allowlist is enabled.

config ZMK_USB_BRIDGE_RECOVERY_BUTTON_DEBOUNCE_MS
    int "Recovery button debounce time (ms)"
    default 30
    range 5 500
    help
      Debounce time used for the external recovery button input.

config ZMK_USB_BRIDGE_RECOVERY_BUTTON_LONG_PRESS_MS
    int "Recovery button long-press time (ms)"
    default 3000
    range 1000 10000
    help
      Hold time required before the external recovery button triggers
      bond erase and returns the bridge to pairing scan.

endmenu
```

## main/Kconfig.projbuild
```kconfig
menu "ZMK USB Bridge"

menu "BLE Pairing Filter"

config ZMK_USB_BRIDGE_PAIRING_NAME_ALLOWLIST_ENABLED
    bool "Enable pairing name allowlist"
    default n
    help
        Adds a local-name allowlist check to unbonded pairing candidate filtering.
        This is a supplementary safeguard only for initial pairing and is not used
        as the identity source after bonding.

config ZMK_USB_BRIDGE_PAIRING_NAME_ALLOWLIST
    string "Pairing name allowlist"
    depends on ZMK_USB_BRIDGE_PAIRING_NAME_ALLOWLIST_ENABLED
    default ""
    help
        Comma-separated list of accepted BLE local names during initial pairing.
        Example: LalapadGen2,MyOtherBoard

endmenu

endmenu
```

## west.yml
```yaml
manifest:
  version: "0.13"

  remotes:
    - name: zephyrproject-rtos
      url-base: https://github.com/zephyrproject-rtos

  projects:
    - name: zephyr
      remote: zephyrproject-rtos
      revision: v4.3.0
      import:
        name-allowlist:
          - cmsis
          - hal_nordic
          - mcuboot
          - mbedtls
          - segger
          - tinycrypt
          - littlefs
          - zcbor

  self:
    path: ShiniNet/zmk-usb-bridge
```
